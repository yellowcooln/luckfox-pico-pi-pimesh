## Config.in
```kconfig
menu "Luckfox Pico Pi external options"

source "$BR2_EXTERNAL_LUCKFOX_PICO_PI_PATH/package/luckfox-pico-pi/Config.in"

endmenu
```

## package/luckfox-pico-pi/Config.in
```kconfig
source "$BR2_EXTERNAL_LUCKFOX_PICO_PI_PATH/package/luckfox-pico-pi/python-httpagentparser/Config.in"
source "$BR2_EXTERNAL_LUCKFOX_PICO_PI_PATH/package/luckfox-pico-pi/python-cherrypy-cors/Config.in"
source "$BR2_EXTERNAL_LUCKFOX_PICO_PI_PATH/package/luckfox-pico-pi/python-autocommand/Config.in"
source "$BR2_EXTERNAL_LUCKFOX_PICO_PI_PATH/package/luckfox-pico-pi/python-backports-tarfile/Config.in"
source "$BR2_EXTERNAL_LUCKFOX_PICO_PI_PATH/package/luckfox-pico-pi/python-jaraco-context/Config.in"
source "$BR2_EXTERNAL_LUCKFOX_PICO_PI_PATH/package/luckfox-pico-pi/python-jaraco-text/Config.in"
source "$BR2_EXTERNAL_LUCKFOX_PICO_PI_PATH/package/luckfox-pico-pi/python-jaraco-collections/Config.in"
source "$BR2_EXTERNAL_LUCKFOX_PICO_PI_PATH/package/luckfox-pico-pi/python-smbus2/Config.in"
source "$BR2_EXTERNAL_LUCKFOX_PICO_PI_PATH/package/luckfox-pico-pi/python-gpiod/Config.in"
source "$BR2_EXTERNAL_LUCKFOX_PICO_PI_PATH/package/luckfox-pico-pi/python-adafruit-pureio/Config.in"
source "$BR2_EXTERNAL_LUCKFOX_PICO_PI_PATH/package/luckfox-pico-pi/python-adafruit-gpio/Config.in"
source "$BR2_EXTERNAL_LUCKFOX_PICO_PI_PATH/package/luckfox-pico-pi/python-mock/Config.in"
source "$BR2_EXTERNAL_LUCKFOX_PICO_PI_PATH/package/luckfox-pico-pi/python-pi-ina219/Config.in"
source "$BR2_EXTERNAL_LUCKFOX_PICO_PI_PATH/package/luckfox-pico-pi/python-pyserial/Config.in"
source "$BR2_EXTERNAL_LUCKFOX_PICO_PI_PATH/package/luckfox-pico-pi/python-pycryptodome/Config.in"
```

## package/luckfox-pico-pi/python-adafruit-pureio/Config.in
```kconfig
config BR2_PACKAGE_PYTHON_ADAFRUIT_PUREIO
	bool "python-adafruit-pureio"
	help
	  Pure Python interfaces for low-level hardware access.

	  https://pypi.org/project/Adafruit-PureIO/
```

## package/luckfox-pico-pi/python-autocommand/Config.in
```kconfig
config BR2_PACKAGE_PYTHON_AUTOCOMMAND
	bool "python-autocommand"
	help
	  Autocommand support helpers for Python packages.

	  https://pypi.org/project/autocommand/
```

## package/luckfox-pico-pi/python-backports-tarfile/Config.in
```kconfig
config BR2_PACKAGE_PYTHON_BACKPORTS_TARFILE
	bool "python-backports-tarfile"
	select BR2_PACKAGE_PYTHON3
	help
	  Backport of the CPython tarfile module used by jaraco.context.

	  https://pypi.org/project/backports.tarfile/
```

## package/luckfox-pico-pi/python-cherrypy-cors/Config.in
```kconfig
config BR2_PACKAGE_PYTHON_CHERRYPY_CORS
	bool "python-cherrypy-cors"
	depends on BR2_PACKAGE_PYTHON_CHERRYPY
	select BR2_PACKAGE_PYTHON_HTTPAGENTPARSER
	help
	  CORS handling as a CherryPy tool.

	  https://pypi.org/project/cherrypy-cors/
```

## package/luckfox-pico-pi/python-gpiod/Config.in
```kconfig
config BR2_PACKAGE_PYTHON_GPIOD
	bool "python-gpiod"
	select BR2_PACKAGE_LIBGPIOD
	help
	  Python bindings for libgpiod.

	  https://pypi.org/project/gpiod/
```

## package/luckfox-pico-pi/python-jaraco-context/Config.in
```kconfig
config BR2_PACKAGE_PYTHON_JARACO_CONTEXT
	bool "python-jaraco-context"
	help
	  Context manager helpers used by jaraco.text.

	  https://pypi.org/project/jaraco.context/
```

## package/luckfox-pico-pi/python-mock/Config.in
```kconfig
config BR2_PACKAGE_PYTHON_MOCK
	bool "python-mock"
	help
	  Backport of Python mock support.

	  https://pypi.org/project/mock/
```

## package/luckfox-pico-pi/python-smbus2/Config.in
```kconfig
config BR2_PACKAGE_PYTHON_SMBUS2
	bool "python-smbus2"
	help
	  Pure Python SMBus access library.

	  https://pypi.org/project/smbus2/
```

## package/luckfox-pico-pi/yq/Config.in
```kconfig
config BR2_PACKAGE_YQ
	bool "yq"
	help
	  Portable YAML processor from mikefarah/yq.

	  https://github.com/mikefarah/yq
```

## package/yellowcooln/Config.in
```kconfig
source "$BR2_EXTERNAL_YELLOWCOOLN_PATH/package/yellowcooln/python-httpagentparser/Config.in"
source "$BR2_EXTERNAL_YELLOWCOOLN_PATH/package/yellowcooln/python-cherrypy-cors/Config.in"
source "$BR2_EXTERNAL_YELLOWCOOLN_PATH/package/yellowcooln/python-autocommand/Config.in"
source "$BR2_EXTERNAL_YELLOWCOOLN_PATH/package/yellowcooln/python-backports-tarfile/Config.in"
source "$BR2_EXTERNAL_YELLOWCOOLN_PATH/package/yellowcooln/python-jaraco-context/Config.in"
source "$BR2_EXTERNAL_YELLOWCOOLN_PATH/package/yellowcooln/python-jaraco-text/Config.in"
source "$BR2_EXTERNAL_YELLOWCOOLN_PATH/package/yellowcooln/python-jaraco-collections/Config.in"
source "$BR2_EXTERNAL_YELLOWCOOLN_PATH/package/yellowcooln/python-smbus2/Config.in"
source "$BR2_EXTERNAL_YELLOWCOOLN_PATH/package/yellowcooln/python-adafruit-pureio/Config.in"
source "$BR2_EXTERNAL_YELLOWCOOLN_PATH/package/yellowcooln/python-adafruit-gpio/Config.in"
source "$BR2_EXTERNAL_YELLOWCOOLN_PATH/package/yellowcooln/python-mock/Config.in"
source "$BR2_EXTERNAL_YELLOWCOOLN_PATH/package/yellowcooln/python-pi-ina219/Config.in"
source "$BR2_EXTERNAL_YELLOWCOOLN_PATH/package/yellowcooln/python-pyserial/Config.in"
source "$BR2_EXTERNAL_YELLOWCOOLN_PATH/package/yellowcooln/python-pycryptodome/Config.in"
```

## package/yellowcooln/python-adafruit-gpio/Config.in
```kconfig
config BR2_PACKAGE_PYTHON_ADAFRUIT_GPIO
	bool "python-adafruit-gpio"
	select BR2_PACKAGE_PYTHON_ADAFRUIT_PUREIO
	help
	  Adafruit GPIO helper library with I2C and SPI helpers.

	  https://pypi.org/project/Adafruit-GPIO/
```

## package/yellowcooln/python-httpagentparser/Config.in
```kconfig
config BR2_PACKAGE_PYTHON_HTTPAGENTPARSER
	bool "python-httpagentparser"
	help
	  HTTP User-Agent header parser.

	  https://pypi.org/project/httpagentparser/
```

## package/yellowcooln/python-jaraco-collections/Config.in
```kconfig
config BR2_PACKAGE_PYTHON_JARACO_COLLECTIONS
	bool "python-jaraco-collections"
	select BR2_PACKAGE_PYTHON_JARACO_TEXT
	help
	  Collection helpers used by CherryPy.

	  https://pypi.org/project/jaraco.collections/
```

## package/yellowcooln/python-jaraco-text/Config.in
```kconfig
config BR2_PACKAGE_PYTHON_JARACO_TEXT
	bool "python-jaraco-text"
	select BR2_PACKAGE_PYTHON_AUTOCOMMAND
	select BR2_PACKAGE_PYTHON_JARACO_CONTEXT
	select BR2_PACKAGE_PYTHON_JARACO_FUNCTOOLS
	select BR2_PACKAGE_PYTHON_MORE_ITERTOOLS
	help
	  Text helpers used by jaraco.collections.

	  https://pypi.org/project/jaraco.text/
```

## package/yellowcooln/python-pi-ina219/Config.in
```kconfig
config BR2_PACKAGE_PYTHON_PI_INA219
	bool "python-pi-ina219"
	select BR2_PACKAGE_PYTHON_ADAFRUIT_GPIO
	select BR2_PACKAGE_PYTHON_MOCK
	help
	  INA219 voltage, current, and power monitor library.

	  https://github.com/chrisb2/pi_ina219/
```
